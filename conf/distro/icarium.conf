## conf/distro/icarium.conf
```bitbake
DISTRO = "icarium"
DISTRO_NAME = "Icarium Distro"
DISTRO_VERSION = "1.0.0"
SDK_VENDOR = "-icarium"
SDK_VERSION = "${@d.getVar('DISTRO_VERSION').replace('snapshot-${DATE}', 'snapshot')}"

MAINTAINER = "Icarium Technologies"

TARGET_VENDOR = "-icarium"

LOCALCONF_VERSION = "1"

DISTRO_VERSION[vardepsexclude] = "DATE"
SDK_VERSION[vardepsexclude] = "DATE"

DISTRO_FEATURES ?= "ipv4 ext2 ext4 largefile multiarch opengl wifi zeroconf ${DISTRO_FEATURES_LIBC}"

SDK_NAME = "${DISTRO}-${TCLIBC}-${SDKMACHINE}-${IMAGE_BASENAME}-${TUNE_PKGARCH}-${MACHINE}"
SDKPATH = "/opt/${DISTRO}/sdk/${SDK_VERSION}"

PREMIRRORS ??= "\
bzr://.*/.*   http://downloads.yoctoproject.org/mirror/sources/ \n \
cvs://.*/.*   http://downloads.yoctoproject.org/mirror/sources/ \n \
git://.*/.*   http://downloads.yoctoproject.org/mirror/sources/ \n \
gitsm://.*/.* http://downloads.yoctoproject.org/mirror/sources/ \n \
hg://.*/.*    http://downloads.yoctoproject.org/mirror/sources/ \n \
osc://.*/.*   http://downloads.yoctoproject.org/mirror/sources/ \n \
p4://.*/.*    http://downloads.yoctoproject.org/mirror/sources/ \n \
svn://.*/.*   http://downloads.yoctoproject.org/mirror/sources/ \n"

#
# OELAYOUT_ABI allows us to notify users when the format of TMPDIR changes in
# an incompatible way. Such changes should usually be detailed in the commit
# that breaks the format and have been previously discussed on the mailing list
# with general agreement from the core team.
#
OELAYOUT_ABI = "12"

# add poky sanity bbclass
INHERIT += "poky-sanity"

# QA check settings - a little stricter than the OE-Core defaults
WARN_TO_ERROR_QA = "already-stripped compile-host-path install-host-path \
                    installed-vs-shipped ldflags pn-overrides rpaths staticdev \
                    unknown-configure-option useless-rpaths"
WARN_QA_remove = "${WARN_TO_ERROR_QA}"
ERROR_QA_append = " ${WARN_TO_ERROR_QA}"

require conf/distro/include/poky-world-exclude.inc
require conf/distro/include/no-static-libs.inc
require conf/distro/include/yocto-uninative.inc
require conf/distro/include/security_flags.inc
INHERIT += "uninative"

# Append additional options for kernel command line
USE_VT = "0"
```

## conf/layer.conf
```bitbake
# We have a conf and classes directory, add to BBPATH
BBPATH .= ":${LAYERDIR}"

# We have a packages directory, add to BBFILES
BBFILES += "${LAYERDIR}/recipes-*/*/*.bb \
            ${LAYERDIR}/recipes-*/*/*.bbappend"



BBFILE_COLLECTIONS += "qtbrew-layer"
BBFILE_PATTERN_qtbrew-layer := "^${LAYERDIR}/"
BBFILE_PRIORITY_qtbrew-layer = "30"
LAYERVERSION_qtbrew-layer = "1"
LAYERSERIES_COMPAT_qtbrew-layer = "warrior"

BBFILES += "${@' '.join('${LAYERDIR}/dynamic-layers/%s/recipes*/*/*.bbappend' % layer \
               for layer in BBFILE_COLLECTIONS.split())}"
BBFILES += "${@' '.join('${LAYERDIR}/dynamic-layers/%s/recipes*/*/*.bb' % layer \
               for layer in BBFILE_COLLECTIONS.split())}"

BBFILES_DYNAMIC += " \
    raspberrypi:${LAYERDIR}/dynamic-layers/raspberrypi-layer/*/*/*.bb \
    raspberrypi:${LAYERDIR}/dynamic-layers/raspberrypi-layer/*/*/*.bbappend \
"
```

## conf/machine/qtbrewpi.conf
```bitbake
#@TYPE: Machine
#@NAME: RaspberryPi 3 Development Board
#@DESCRIPTION: Machine configuration for the RaspberryPi 3 in 64 bits mode

MACHINEOVERRIDES = "raspberrypi3:raspberrypi3-64:${MACHINE}"

MACHINE_EXTRA_RRECOMMENDS += "\
    linux-firmware-rpidistro-bcm43430 \
    linux-firmware-rpidistro-bcm43455 \
"

require conf/machine/include/tune-cortexa53.inc
include conf/machine/include/rpi-base.inc

KERNEL_DEVICETREE = " \
    broadcom/bcm2710-rpi-3-b-plus.dtb \
    overlays/rpi-ft5406.dtbo \
    overlays/vc4-fkms-v3d.dtbo \
    "

SERIAL_CONSOLES ?= "115200;ttyS0"

UBOOT_MACHINE = "rpi_3_config"

VC4DTBO ?= "vc4-fkms-v3d"

# When u-boot is enabled we need to use the "Image" format and the "booti"
# command to load the kernel
KERNEL_IMAGETYPE_UBOOT ?= "Image"
# "zImage" not supported on arm64 and ".gz" images not supported by bootloader yet
KERNEL_IMAGETYPE_DIRECT ?= "Image"
KERNEL_BOOTCMD ?= "booti"

ARMSTUB ?= "armstub8.bin"

SPLASH = "psplash-brewerycontroller"

ENABLE_SPI_BUS = "1"
DISABLE_SPLASH = "1"
ENABLE_UART = "1"

IMAGE_FSTYPES = "tar.bz2 ext3 rpi-sdimg cpio.gz"
```

## conf/machine/qtbrewpi4.conf
```bitbake
#@TYPE: Machine
#@NAME: RaspberryPi 4 Development Board
#@DESCRIPTION: Machine configuration for the RaspberryPi 3 in 64 bits mode

MACHINEOVERRIDES = "raspberrypi4:raspberrypi4-64:${MACHINE}"

MACHINE_EXTRA_RRECOMMENDS += "\
    linux-firmware-rpidistro-bcm43455 \
    bluez-firmware-rpidistro-bcm4345c0-hcd \
"

require conf/machine/include/tune-cortexa72.inc
include conf/machine/include/rpi-base.inc

KERNEL_DEVICETREE = " \
    broadcom/bcm2711-rpi-4-b.dtb \
    overlays/rpi-ft5406.dtbo \
    overlays/vc4-fkms-v3d.dtbo \
    "

SDIMG_KERNELIMAGE = "kernel8.img"
SERIAL_CONSOLES ?= "115200;ttyS0"

UBOOT_MACHINE = "rpi_4_config"

VC4DTBO ?= "vc4-fkms-v3d"

# When u-boot is enabled we need to use the "Image" format and the "booti"
# command to load the kernel
KERNEL_IMAGETYPE_UBOOT ?= "Image"
# "zImage" not supported on arm64 and ".gz" images not supported by bootloader yet
KERNEL_IMAGETYPE_DIRECT ?= "Image"
KERNEL_BOOTCMD ?= "booti"

ARMSTUB ?= "armstub8-gic.bin"

ENABLE_SPI_BUS = "1"
DISABLE_SPLASH = "1"
ENABLE_UART = "1"

IMAGE_CLASSES += "sdcard_image-qtbrew"

IMAGE_FSTYPES = "cpio.gz qtbrew-sdimg"

CMDLINE = "initrd=initrd.cpio.gz dwc_otg.lpm_enable=0 console=serial0,115200 consoleblank=0 vt.global_cursor_default=0"

RPI_EXTRA_CONFIG = "initramfs initrd.cpio.gz \narm_64bit=1\n"
```
